## config/boards/shields/dactyl/Kconfig.defconfig
```kconfig
if SHIELD_DACTYL_LEFT

config ZMK_KEYBOARD_NAME
    default "Dactyl"

config ZMK_SPLIT_ROLE_CENTRAL
    default y

config ZMK_MOCK_DEVICE
    default y
endif

if SHIELD_DACTYL_LEFT || SHIELD_DACTYL_RIGHT

config ZMK_SPLIT
    default y

config ZMK_SLEEP
    default y

config ZMK_IDLE_SLEEP_TIMEOUT
    default 900000 # 15 minutes (900000 milliseconds)

config ZMK_KEYBOARD_NAME
    default "Dactyl"

config ZMK_BLE
    default y

config ZMK_BATTERY_REPORTING
    default y

config ZMK_POINTING
        default y

config INPUT
    default y
endif

if SHIELD_DACTYL_RIGHT

config SPI
    default y

config PMW3610_ALT
    default y

config ZMK_INPUT_SPLIT
    default y
endif
```

## config/boards/shields/dactyl/Kconfig.shield
```kconfig
config SHIELD_DACTYL_LEFT
    def_bool $(shields_list_contains,dactyl_left)

config SHIELD_DACTYL_RIGHT
    def bool $(shields_list_contains,dactyl_right)
```
